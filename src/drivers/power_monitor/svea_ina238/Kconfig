## src/drivers/power_monitor/svea_ina238/Kconfig
```kconfig
menuconfig DRIVERS_POWER_MONITOR_SVEA_INA238
	bool "svea_ina238"
	default n
	---help---
		Enable support for SVEA INA238
```

## src/drivers/temperature_sensor/mcp9600/Kconfig
```kconfig
menuconfig DRIVERS_TEMPERATURE_SENSOR_MCP9600
	bool "MCP9600 thermocouple temperature sensor"
	default n
	---help---
		Enable support for the Microchip MCP9600 thermocouple-to-temperature converter
```
